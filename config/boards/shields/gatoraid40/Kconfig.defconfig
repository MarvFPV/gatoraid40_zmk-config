## config/boards/shields/gatoraid40/Kconfig.defconfig
```kconfig
# Copyright (c) 2021 The ZMK Contributors
# SPDX-License-Identifier: MIT

if SHIELD_GATORAID40

config ZMK_KEYBOARD_NAME
    default "gatoraid40"

endif
```

## config/boards/shields/gatoraid40/Kconfig.shield
```kconfig
# Copyright (c) 2021 The ZMK Contributors
# SPDX-License-Identifier: MIT

config SHIELD_GATORAID40
    def_bool $(shields_list_contains,gatoraid40)
```
